## meta-gir-clutter/conf/layer.conf
```bitbake
# We have a conf and classes directory, add to BBPATH
BBPATH .= ":${LAYERDIR}"
# We have a packages directory, add to BBFILES
BBFILES += "${LAYERDIR}/recipes-*/*/*.bb \
	    ${LAYERDIR}/recipes-*/*/*.bbappend"

BBFILE_COLLECTIONS += "gir-clutter"
BBFILE_PATTERN_gir-clutter = "^${LAYERDIR}/"
BBFILE_PRIORITY_gir-clutter = "6"
```

## meta-gir-core/conf/layer.conf
```bitbake
# We have a conf and classes directory, add to BBPATH
BBPATH .= ":${LAYERDIR}"
# We have a packages directory, add to BBFILES
BBFILES += "${LAYERDIR}/recipes-*/*/*.bb \
	    ${LAYERDIR}/recipes-*/*/*.bbappend"

BBFILE_COLLECTIONS += "gir-core"
BBFILE_PATTERN_gir-core = "^${LAYERDIR}/"
BBFILE_PRIORITY_gir-core = "6"
```

## meta-gir/conf/layer.conf
```bitbake
# We have a conf and classes directory, add to BBPATH
BBPATH .= ":${LAYERDIR}"
# We have a packages directory, add to BBFILES
BBFILES += "${LAYERDIR}/recipes-*/*/*.bb \
	    ${LAYERDIR}/recipes-*/*/*.bbappend"

BBFILE_COLLECTIONS += "gir"
BBFILE_PATTERN_gir = "^${LAYERDIR}/"
BBFILE_PRIORITY_gir = "6"
```
